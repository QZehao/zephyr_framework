## Kconfig
```kconfig
# Kconfig for Event-Driven Project Template
# SPDX-License-Identifier: Apache-2.0

# Source Zephyr's base Kconfig to get all standard symbols
# (ZTEST, LOG, HEAP_MEM_POOL_SIZE, CONSOLE, SERIAL, GPIO, etc.)
rsource "Kconfig.zephyr"

menu "Event System Configuration"

config EVENT_SYSTEM
	bool "Enable Event System"
	default y
	help
	  Enable the core event-driven architecture for the application.

config EVENT_MAX_TYPES
	int "Maximum Event Types"
	default 256
	range 4 256
	help
	  Maximum number of event types supported.
	  Each type uses approximately 288 bytes (with 16 subscribers).
	  For 32KB SRAM systems, use 16 or less to save memory.

config EVENT_QUEUE_SIZE
	int "Event Queue Size"
	default 64
	range 4 512
	help
	  Maximum number of events that can be queued.

config EVENT_MAX_SUBSCRIBERS
	int "Maximum Event Subscribers"
	default 16
	range 1 64
	help
	  Maximum number of subscribers per event type.

config EVENT_DISPATCHER_STACK_SIZE
	int "Event Dispatcher Stack Size"
	default 2048
	range 256 8192
	help
	  Stack size for the event dispatcher thread.

config EVENT_DISPATCHER_PRIORITY
	int "Event Dispatcher Priority"
	default 5
	range 1 15
	help
	  Priority of the event dispatcher thread (lower = higher priority).

config EVENT_DISPATCHER_MAX_EVENTS_PER_CYCLE
	int "Max Events Per Cycle"
	default 100
	range 1 10000
	help
	  Maximum number of events processed in a single dispatcher cycle.
	  Limits processing time per cycle to prevent starving other threads.

	# =============================================================================
	# Event Structure Size Configuration
	# =============================================================================

	choice
		prompt "Event structure size"
		default EVENT_STRUCT_SIZE_64
		help
		  Select event_t structure size. Larger size provides more inline
		  data capacity but consumes more memory per event.

	config EVENT_STRUCT_SIZE_32
		bool "32 bytes (compact)"
		help
		  Minimal footprint. Inline data: 16 bytes.
		  Recommended for < 16KB RAM devices.

	config EVENT_STRUCT_SIZE_64
		bool "64 bytes (balanced)"
		help
		  Good balance. Inline data: 48 bytes.
		  Recommended for 16KB-256KB RAM devices.

	config EVENT_STRUCT_SIZE_128
		bool "128 bytes (high capacity)"
		help
		  Maximum inline capacity. Inline data: 112 bytes.
		  Recommended for > 256KB RAM devices.

	endchoice

	config EVENT_STRUCT_SIZE
		int
		default 32 if EVENT_STRUCT_SIZE_32
		default 64 if EVENT_STRUCT_SIZE_64
		default 128 if EVENT_STRUCT_SIZE_128

	config EVENT_INLINE_DATA_SIZE
		int
		default 16 if EVENT_STRUCT_SIZE_32
		default 48 if EVENT_STRUCT_SIZE_64
		default 112 if EVENT_STRUCT_SIZE_128

	# =============================================================================
	# Event Slab Memory Configuration
	# =============================================================================

	config EVENT_SLAB_ENABLE
		bool "Enable slab-based memory management"
		default y
		help
		  Use k_mem_slab for deterministic O(1) memory allocation.
		  Disable to fall back to k_malloc (not real-time safe).

	if EVENT_SLAB_ENABLE

	config EVENT_SLAB_CRITICAL_COUNT
		int "CRITICAL priority event pool size"
		default 8
		range 0 64
		help
		  Number of event_t blocks reserved for CRITICAL priority.
		  Set to 0 to share with NORMAL pool.

	config EVENT_SLAB_HIGH_COUNT
		int "HIGH priority event pool size"
		default 16
		range 0 64
		help
		  Number of event_t blocks reserved for HIGH priority.
		  Set to 0 to share with NORMAL pool.

	config EVENT_SLAB_NORMAL_COUNT
		int "NORMAL/LOW priority event pool size"
		default 32
		range 4 128
		help
		  Number of event_t blocks for NORMAL and LOW priority events.

	config EVENT_SLAB_LARGE_ENABLE
		bool "Enable large data slab pools"
		default y
		help
		  Enable slab pools for event data larger than inline threshold.
		  Disable to use k_malloc for large data (not real-time safe).

	if EVENT_SLAB_LARGE_ENABLE

	config EVENT_SLAB_LARGE_256_COUNT
		int "256-byte data block count"
		default 8
		range 0 32
		help
		  Number of 256-byte blocks for event data (up to 256 bytes).
		  Each block consumes 256 bytes. Set to 0 to disable this tier.

	config EVENT_SLAB_LARGE_1K_COUNT
		int "1KB data block count"
		default 4
		range 0 16
		help
		  Number of 1KB blocks for event data (up to 1KB).
		  Each block consumes 1024 bytes. Set to 0 to disable this tier.

	config EVENT_SLAB_LARGE_4K_COUNT
		int "4KB data block count"
		default 2
		range 0 8
		help
		  Number of 4KB blocks for large event data (up to 4KB).
		  Each block consumes 4096 bytes. Set to 0 to disable this tier.

	endif # EVENT_SLAB_LARGE_ENABLE

	endif # EVENT_SLAB_ENABLE

	# =============================================================================
	# Event Extended Features
	# =============================================================================

	config EVENT_SLAB_EXHAUSTED_CB
		bool "Enable slab exhausted callback"
		default n
		help
		  Invoke callback when a slab pool is exhausted.

	config EVENT_DEBUG_MEM
		bool "Enable memory debugging support"
		default n
		help
		  Enable leak detection and memory diagnostics.
		  Increases memory usage, for development only.

	config EVENT_RUNTIME_STATUS
		bool "Enable runtime pool status query"
		default y
		help
		  Provide APIs to query slab availability at runtime.

	config EVENT_SLAB_STATS_DETAILED
		bool "Enable detailed slab statistics"
		default n
		depends on EVENT_RUNTIME_STATUS
		help
		  Track detailed statistics including allocation counts
		  and high watermarks.

endmenu

menu "Module Manager Configuration"

config MODULE_MANAGER
	bool "Enable Module Manager"
	default y
	help
	  Enable dynamic module registration and management.

config MAX_MODULES
	int "Maximum Number of Modules"
	default 16
	range 1 32
	help
	  Maximum number of modules that can be registered.

config MODULE_INIT_TIMEOUT_MS
	int "Module Initialization Timeout (ms)"
	default 1000
	range 100 10000
	help
	  Timeout for module initialization.

config MODULE_MANAGER_RUNTIME_DEPENDENCIES
	bool "Runtime module dependency ordering"
	depends on MODULE_MANAGER
	default n
	help
	  When enabled, module_manager_start_all() orders startup by each module's
	  depends_on list (module names, NULL-terminated). Dependencies must be
	  running or included in the same start batch. If a module is dropped from
	  the batch due to invalid deps, dependents are re-checked until fixed point
	  so a module is not started while its dependency is missing from the batch.
	  module_manager_stop_all() stops in reverse dependency order on the RUNNING
	  set. Missing edges or cycles fall back to priority-only ordering (start)
	  or reverse priority (stop). When disabled, behavior matches the original
	  priority-only start and slot-order stop.

config MODULE_MANAGER_DEPENDS_LIST_MAX
	int "Max dependency names per module (iterate guard)"
	depends on MODULE_MANAGER_RUNTIME_DEPENDENCIES
	default 16
	range 4 64
	help
	  English:
	    Maximum number of dependency-name pointers scanned for a single module's
	    depends_on[] array (each entry is another module's interface->name; the
	    list must end with NULL). This is an iterate guard so a missing NULL
	    terminator cannot loop forever. It is NOT the total number of modules in
	    the system (see MAX_MODULES), and NOT the depth of a dependency chain
	    (e.g. A->B->C is depth 2, but this option does not measure that).
	  中文:
	    单个模块的 depends_on 指针数组里，最多扫描多少个「依赖模块名字符串」
	    （最后一项之后必须是 NULL）。用于防止未正确 NULL 终止时死循环。
	    不是全系统已注册模块的总数（见 MAX_MODULES），也不是依赖链路的深度
	    （例如 A 依赖 B、B 依赖 C 的层数与本项无关）。

config MODULE_MANAGER_START_ALL_ABORT_ON_FAILURE
	bool "Abort start_all after first start failure"
	depends on MODULE_MANAGER
	default n
	help
	  When enabled, module_manager_start_all() stops after the first
	  module_manager_start_module() returns non-zero. Recommended when using
	  runtime dependencies so dependents are not started after a failed dependency.

config EXAMPLE_MODULE_MULTI_DEP
	bool "Example: module with multiple runtime dependencies (A + B)"
	depends on MODULE_MANAGER
	default n
	help
	  English:
	    Builds and registers example_module_multi_dep, which sets depends_on to
	    example_module_a and example_module_b (see example_module_multi_dep.c).
	    For meaningful ordering, enable CONFIG_MODULE_MANAGER_RUNTIME_DEPENDENCIES
	    and register modules A and B (e.g. APP_CONFIG_ENABLE_MODULE_A/B in app_config.h).
	  中文:
	    编译并注册多依赖示例模块，depends_on 指向 example_module_a 与 example_module_b。
	    若需拓扑排序生效，请开启 CONFIG_MODULE_MANAGER_RUNTIME_DEPENDENCIES，并确保 A/B 已注册。

config EXAMPLE_MODULE_GPIO
	bool "Example: GPIO module (LED + optional user button sw0)"
	depends on MODULE_MANAGER
	default n
	help
	  Builds example_module_gpio. Requires devicetree alias led0; optional sw0 for button.
	  See boards overlay and docs/zh-CN/30-核心模块/32-模块系统详细使用说明.md.

config EXAMPLE_MODULE_UART
	bool "Example: UART module (poll TX + IRQ RX ring)"
	depends on MODULE_MANAGER
	default n
	help
	  Builds example_module_uart. Default binding is chosen zephyr_console UART;
	  may share the same port as Shell/LOG — see help on EXAMPLE_MODULE_UART_USE_ZEPHYR_CONSOLE.

config EXAMPLE_MODULE_UART_USE_ZEPHYR_CONSOLE
	bool "Bind UART example to chosen zephyr_console device"
	depends on EXAMPLE_MODULE_UART
	default y
	help
	  When enabled, the module uses DEVICE_DT_GET(DT_CHOSEN(zephyr_console)).
	  When disabled, device_get_binding(CONFIG_EXAMPLE_MODULE_UART_DEVICE_NAME) is used.

config EXAMPLE_MODULE_UART_DEVICE_NAME
	string "UART device name (when USE_ZEPHYR_CONSOLE is disabled)"
	depends on EXAMPLE_MODULE_UART
	default "UART_0"

config EXAMPLE_MODULE_A_ENABLE
	bool "Enable Example Module A (Sensor Simulator)"
	depends on MODULE_MANAGER
	default y
	help
	  Enable example_module_a which simulates sensor data publishing.

config EXAMPLE_MODULE_B_ENABLE
	bool "Enable Example Module B (Communication)"
	depends on MODULE_MANAGER
	default y
	help
	  Enable example_module_b which simulates communication module.

endmenu

menu "System Services Configuration"

config SYS_LOG_LEVEL
	int "System Log Level"
	default 3
	range 0 4
	help
	  0=OFF, 1=ERROR, 2=WARNING, 3=INFO, 4=DEBUG

config SYS_LOG_ENABLE
	bool "Enable System Log Service"
	default y
	help
	  Enable the system log service with memory buffering.

config SYS_MEMORY_POOL_SIZE
	int "System Memory Pool Size"
	default 8192
	range 0 65536
	help
	  Size of the system memory pool for event allocations.
	  Set to 0 to disable the memory pool service.

config SYS_MEMORY_ENABLE
	bool "Enable System Memory Service"
	default y
	help
	  Enable the system memory pool management with tracking.

config SYS_TIMER_ENABLE
	bool "Enable System Timer Service"
	default y
	help
	  Enable the system timer service for software timers.

config SYS_WATCHDOG_ENABLE
	bool "Enable System Watchdog"
	default y
	help
	  Enable hardware/software watchdog for system reliability.

config SYS_WATCHDOG_TIMEOUT_MS
	int "Watchdog Timeout (ms)"
	default 5000
	range 1000 30000
	help
	  Watchdog timeout in milliseconds.

config SYS_WATCHDOG_DEFAULT_MODE
	int "Default Watchdog Mode"
	default 0
	range 0 2
	help
	  Default watchdog mode when initialized with NULL config:
	    0 = Software only (WDT_MODE_SOFTWARE)
	    1 = Hardware only (WDT_MODE_HARDWARE)
	    2 = Dual mode (WDT_MODE_DUAL)

	  Note: If hardware watchdog is not available, it will fallback
	  to software mode automatically.

config SYS_WATCHDOG_FORCE_RESET
	bool "Force System Reset on Watchdog Expiry"
	default n
	depends on SYS_WATCHDOG_ENABLE
	select REBOOT
	help
	  When enabled, the system will execute a hardware reset via
	  sys_reboot() when watchdog expires.

	  For development/testing, leave this disabled to prevent
	  unwanted resets. Enable for production builds.

config WATCHDOG
	bool "Enable Zephyr Watchdog Driver"
	default y
	help
	  Enable Zephyr's watchdog driver. This is required for
	  hardware watchdog support.

endmenu

menu "Application Features Configuration"

config APP_ENABLE_SHELL
	bool "Enable Shell Support"
	default y
	depends on SHELL
	help
	  Enable shell commands for application debugging and control.
	  Requires CONFIG_SHELL=y in your prj.conf.

config APP_ENABLE_STATS
	bool "Enable Statistics Collection"
	default y
	help
	  Enable statistics collection for event dispatcher and modules.

config APP_ENABLE_LOG_DUMP
	bool "Enable Log Dump Command"
	default y
	depends on SYS_LOG_ENABLE
	help
	  Enable sys_log_dump shell command to dump buffered logs.

config APP_HEARTBEAT_INTERVAL_MS
	int "Application Heartbeat Interval (ms)"
	default 1000
	range 0 10000
	help
	  Interval for application heartbeat timer.
	  Set to 0 to disable heartbeat.

endmenu

menu "Application KV store"

config APP_KV_ENABLE
	bool "Enable application string KV store (RAM)"
	default y
	help
	  Enable in-memory key-value store for application string data.

config APP_KV_MAX_ENTRIES
	int "Maximum KV store entries"
	depends on APP_KV_ENABLE
	default 16
	range 4 64
	help
	  Maximum number of key-value pairs in the KV store.

config APP_KV_KEY_MAX_LEN
	int "Maximum KV key length"
	depends on APP_KV_ENABLE
	default 32
	range 8 128
	help
	  Maximum length of KV store keys (bytes).

config APP_KV_VALUE_MAX_LEN
	int "Maximum KV value length"
	depends on APP_KV_ENABLE
	default 128
	range 16 512
	help
	  Maximum length of KV store values (bytes).

config APP_KV_PERSIST
	bool "Persist app string KV to flash (Settings/NVS)"
	default n
	depends on FLASH
	depends on FLASH_MAP
	depends on NVS
	depends on SETTINGS_NVS
	help
	  When enabled, app_kv_save()/app_kv_load() and optional autosave write a single
	  blob to flash via Zephyr settings (NVS backend).

	  需要在 prj.conf 中启用以下依赖：
	  - CONFIG_FLASH=y
	  - CONFIG_FLASH_MAP=y
	  - CONFIG_NVS=y
	  - CONFIG_SETTINGS=y
	  - CONFIG_SETTINGS_NVS=y（choice 符号，必须显式设置）

	  Requires devicetree chosen zephyr,settings-partition (e.g. boards/nucleo_l4r5zi.overlay).

	  Do not enable on boards without flash (e.g. native_posix smoke tests).

config APP_KV_PERSIST_AUTOSAVE
	bool "Autosave app_kv to flash on each set/remove/clear"
	depends on APP_KV_PERSIST
	default n
	help
	  Wears flash faster. When disabled, call app_kv_save() or shell \"app kv save\".

endmenu

menu "Thread IPC service (in-app)"

rsource "src/modules/ipc_service/Kconfig"

endmenu

# 商业模块配置（可选，当 src/proprietary 不存在时自动跳过）
osource "Kconfig_proprietary"
```

## Kconfig.zephyr
```kconfig
# SPDX-License-Identifier: Apache-2.0

# This file sources Zephyr's base Kconfig.zephyr for freestanding applications.
# In Zephyr 4.x, the application's Kconfig file becomes the root Kconfig,
# so we MUST source Kconfig.zephyr to get all standard Zephyr symbols.

# ZEPHYR_BASE is exported by the Zephyr CMake package before Kconfig runs
rsource "$ZEPHYR_BASE/Kconfig.zephyr"
```

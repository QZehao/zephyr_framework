## src/data_bus/Kconfig
```kconfig
menu "Data Bus (Standard)"

config DATA_BUS
    bool "Enable Data Bus module"
    default n
    help
      Named-channel, reference-counted stream data sharing.
      Completely independent from the event system.

config DATA_BUS_CHANNEL_NAME_MAX
    int "Maximum channel name length (including NUL terminator)"
    default 16
    range 8 64
    depends on DATA_BUS
    help
      Name buffer size used in channel creation, lookup, and
      event bridge notifications.
      Must match data_bus_event_notification_t::channel_name array size.

config DATA_BUS_MAX_CHANNELS
    int "Maximum number of channels"
    default 8
    depends on DATA_BUS

config DATA_BUS_MAX_CONSUMERS_PER_CHANNEL
    int "Maximum consumers per channel"
    default 4
    depends on DATA_BUS

config DATA_BUS_CHANNEL_QUEUE_DEPTH
    int "Channel queue depth (block pointer count)"
    default 16
    depends on DATA_BUS

config DATA_BUS_MAX_BLOCKS
    int "Maximum concurrent blocks (data_bus_block_t slab size)"
    default 32
    depends on DATA_BUS
    help
      Maximum number of data_bus_block_t structures in the system
      at any time. Should be >= total count of all data slab blocks
      to cover both slab and k_malloc fallback scenarios.

config DATA_BUS_DISPATCHER_STACK_SIZE
    int "Dispatcher thread stack size"
    default 2048
    depends on DATA_BUS

config DATA_BUS_DISPATCHER_PRIORITY
    int "Dispatcher thread priority"
    default 5
    depends on DATA_BUS

config DATA_BUS_SLAB_ENABLE
    bool "Enable data bus slab pool"
    default y
    depends on DATA_BUS

config DATA_BUS_SLAB_256_COUNT
    int "256-byte slab block count"
    default 8
    depends on DATA_BUS_SLAB_ENABLE

config DATA_BUS_SLAB_1K_COUNT
    int "1KB slab block count"
    default 4
    depends on DATA_BUS_SLAB_ENABLE

config DATA_BUS_SLAB_4K_COUNT
    int "4KB slab block count"
    default 2
    depends on DATA_BUS_SLAB_ENABLE

config DATA_BUS_EVENT_BRIDGE
    bool "Bridge data bus notifications to event system"
    default y
    depends on DATA_BUS && EVENT_SYSTEM

config DATA_BUS_DEBUG_REFCNT
    bool "Debug: reference count assertions in destroy/deinit"
    default n
    depends on DATA_BUS
    help
      Check abnormal ref_count during channel_destroy and deinit
      to help locate unpaired release causing slab exhaustion.

config DATA_BUS_LOG_LEVEL
    int "Log level"
    default 3
    range 0 4
    depends on DATA_BUS
    help
      0=OFF, 1=ERROR, 2=WARNING, 3=INFO, 4=DEBUG
      Set to 0 or 1 for production to reduce code size.

endmenu
```

## src/modules/ipc_service/Kconfig
```kconfig
#
# Copyright (c) 2024 Your Name
#
# SPDX-License-Identifier: Apache-2.0
#

menuconfig THREAD_IPC_SERVICE
	bool "Thread IPC service (in-app request/response)"
	default n
	help
	  In-application thread-based IPC: worker thread + dispatcher thread,
	  message queues, sync / async / future call modes.

	  Note: This is NOT Zephyr's subsys IPC Service (RPMSG/icmsg backends).
	  Name THREAD_IPC_SERVICE avoids Kconfig symbol collision with upstream
	  CONFIG_IPC_SERVICE.

	  Memory footprint (default config):
	    - Base: ~2.5 KB (stacks, queues, pending table, futures)
	    - Shared mem: ~4 KB (4 blocks × 256B + metadata)
	    - Total: ~6.5 KB

	  For 20KB SRAM systems, use minimal config:
	    - STACK_SIZE=1024, MAX_PENDING=4, QUEUE_SIZE=4
	    - SHARED_MEM_POOL_SIZE=4, SHARED_MEM_BLOCK_SIZE=128
	    - Total: ~3 KB

if THREAD_IPC_SERVICE

config THREAD_IPC_SERVICE_MAX_PENDING_REQUESTS
    int "Maximum pending requests"
    default 8
    range 2 64
    help
      Maximum number of pending requests that can be tracked at any time.
      Each slot uses ~76 bytes. Reduce for memory-constrained systems.

config THREAD_IPC_SERVICE_REQUEST_QUEUE_SIZE
    int "Request queue depth"
    default 4
    range 2 32
    help
      Number of request messages the worker queue can hold (static buffer).
      Each message uses ~56 bytes. Reduce for memory-constrained systems.

config THREAD_IPC_SERVICE_RESPONSE_QUEUE_SIZE
    int "Response queue depth"
    default 4
    range 2 32
    help
      Number of response messages the dispatcher queue can hold (static buffer).
      Each message uses ~48 bytes. Reduce for memory-constrained systems.

config THREAD_IPC_SERVICE_STACK_SIZE
    int "Per-thread stack size (worker + dispatcher)"
    default 1024
    range 512 8192
    help
      Stack size in bytes for each of the two internal threads (embedded in
      ipc_service_t). No kernel heap is required.

      For simple services: 512-1024 bytes may be sufficient.
      For complex services with deep call chains: 2048+ bytes recommended.

config THREAD_IPC_SERVICE_PRIORITY
    int "Thread priority (worker and dispatcher)"
    default 5
    range -16 15
    help
      Priority for worker and dispatcher threads.

config THREAD_IPC_SERVICE_LOG_LEVEL
    int "Log level"
    default 1
    range 0 4
    help
      0=OFF, 1=ERROR, 2=WARNING, 3=INFO, 4=DEBUG
      Set to 0 or 1 for production to reduce code size.

config THREAD_IPC_SERVICE_EXAMPLE
    bool "Build thread IPC example"
    default n
    depends on THREAD_IPC_SERVICE
    help
      Example SYS_INIT + demo thread (sync/async/future).
      Disable for production builds.

config THREAD_IPC_SERVICE_EVENT_BRIDGE
    bool "Bridge: publish IPC results to event system"
    default n
    depends on THREAD_IPC_SERVICE && EVENT_SYSTEM
    help
      Provides ipc_service_event.h/c: register event type THREAD_IPC_EVENT_TYPE_RESPONSE
      and thread_ipc_event_publish_result() for use inside ipc_service_func_t.

config THREAD_IPC_SERVICE_SHARED_MEM
    bool "Shared memory pool with reference counting"
    default y
    depends on THREAD_IPC_SERVICE
    help
      Enable shared memory pool with automatic reference counting for safe
      cross-thread data transfer. Solves:
      1. Unclear ownership - service function returned data lifecycle is unclear
      2. No reference counting - caller must guarantee buffer validity
      3. No safe sharing mechanism - no protection for cross-thread data

      Disable to save ~500 bytes code + pool memory if not needed.

config THREAD_IPC_SERVICE_SHARED_MEM_POOL_SIZE
    int "Shared memory pool block count"
    default 4
    range 2 128
    depends on THREAD_IPC_SERVICE_SHARED_MEM
    help
      Number of shared memory blocks in the static pool.
      Each block adds ~48 bytes metadata overhead.

      For 20KB SRAM: 2-4 blocks recommended.
      For 64KB+ SRAM: 8-16 blocks may be appropriate.

config THREAD_IPC_SERVICE_SHARED_MEM_BLOCK_SIZE
    int "Shared memory block size (bytes)"
    default 256
    range 64 4096
    depends on THREAD_IPC_SERVICE_SHARED_MEM
    help
      Size of each shared memory block in bytes.

      For small payloads (<100 bytes): 128-256 bytes.
      For larger payloads: 512-1024 bytes.

      Total shared memory = POOL_SIZE × BLOCK_SIZE.

config THREAD_IPC_SERVICE_SHARED_MEM_LOG_LEVEL
    int "Shared memory log level"
    default 1
    range 0 4
    depends on THREAD_IPC_SERVICE_SHARED_MEM
    help
      0=OFF, 1=ERROR, 2=WARNING, 3=INFO, 4=DEBUG
      Set to 0 or 1 for production to reduce code size.

config EXAMPLE_MODULE_THREAD_IPC
    bool "Example: business module integrating Thread IPC (module_manager)"
    default n
    depends on THREAD_IPC_SERVICE && MODULE_MANAGER
    help
      Builds example_module_ipc.c: registers with module_manager, ipc_service in
      init/start/stop, optional demo thread calling ipc_call_sync.

endif # THREAD_IPC_SERVICE
```

## tests/Kconfig
```kconfig
# SPDX-License-Identifier: Apache-2.0
#
# 单元测试应用复用仓库根目录 Kconfig（事件系统、模块管理、IPC 等选项）。

rsource "../Kconfig"
```

## west.yml
```yaml
# West manifest file for zephyr_template
#
# This is a FREESTANDING APPLICATION - the application and Zephyr are in
# separate directories. This west.yml is OPTIONAL and is only needed if you
# want to use west commands that require a workspace.
#
# For freestanding applications, you have two options:
#
# Option 1: Use ZEPHYR_BASE environment variable (recommended)
#   - Set ZEPHYR_BASE to point to your Zephyr installation
#   - Build with: west build -b <board>
#
# Option 2: Use this west.yml to create a local workspace
#   - Run: west init -l .
#   - Run: west update
#   - Build with: west build -b <board>
#
# See: https://docs.zephyrproject.org/latest/application/index.html#zephyr-freestanding-app

manifest:
  version: 0.13

  projects:
    - name: zephyr
      path: zephyr
      # Update this path to your Zephyr installation
      url: file://D:/Code/1-github-code/zephyrproject/zephyr
      # 建议改为与 CI / 本地验证一致的 tag，例如 v3.6.0，避免 main 漂移
      revision: main
      # Disable import for freestanding applications
      # import: true

  self:
    # This application is located in the manifest repository itself
    path: .
```

/*
 * Copyright (c) 2026
 * SPDX-License-Identifier: Apache-2.0
 */

/*
 * Sample device tree overlay for zephyr_template
 *
 * 注意：本文件不会自动加载！仅作为示例模板。
 * 用法：
 *   1. 重命名为 boards/<board_name>.overlay（如 boards/nucleo_h743zi.overlay）
 *   2. 或使用 west build -- -DDTC_OVERLAY_FILE=boards/overlay.dts 显式指定
 *
 * GPIO 示例模块需要板级 DTS 提供 led0（必选）与 sw0（可选）等别名，勿在此引用
 * 不存在的节点标签。若你的板使用其它按键节点，可在本文件或板级 overlay 中增加：
 *   / { aliases { sw0 = &your_button; }; };
 */

&gpio0 {
	status = "okay";
};

&uart0 {
	status = "okay";
	current-speed = <115200>;
};

/*
 * Example: Add a sample sensor node
 * Uncomment and modify for your hardware
 */
/*
&i2c0 {
	status = "okay";

	sensor_example: sensor@40 {
		compatible = "vendor,sensor-model";
		reg = <0x40>;
		interrupt-parent = <&gpio0>;
		interrupts = <5 IRQ_TYPE_EDGE_FALLING>;
	};
};
*/

/*
 * Example: Add a sample SPI device
 */
/*
&spi0 {
	status = "okay";
	cs-gpios = <&gpio0 4 GPIO_ACTIVE_LOW>;

	device_example: device@0 {
		compatible = "vendor,device-model";
		reg = <0>;
		spi-max-frequency = <10000000>;
	};
};
*/
